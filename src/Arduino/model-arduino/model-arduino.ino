#include <math.h>

#define NUM_ROWS 50
//#define NUM_COLS 4

int k = 3;

float temp;
float hum;
float lux;
float member_label;

float fan_speed;
float ac_value;

bool enabledUserPref = true;

int i = 0;



void setup() {
  Serial.begin(9600);
  Serial.println("Training started ...");
}

void loop() {
  //if (enabledUserPref)
  //{
    //x_train[i][0] = member_label;
    //x_train[i][1] = temp;
    //x_train[i][2] = hum;
    //x_train[i][3] = lux;

    //y_train[i][0] = fan_speed;
    //y_train[i][1] = ac_value;
    //i++;
  //} 
  float y_train[NUM_ROWS][2] = {
    {1,18.824333257552507},
    {5,20.322462170529583},
    {0,16.237766853414136},
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    {1,18.215361308986196}};

  float x_train[NUM_ROWS][4] = {
    {1,38,27.30333160501536,76.49419267380084},
    {0,76,28.779655219901045,51.73675327705011},
    {0,6,26.63583869393817,59.913775694336906},
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    {1,5,28.697260343894644,74.27363834673686}};
  
  i = NUM_ROWS;
  if (i >= NUM_ROWS)
  {

    delay(10000);
    randomSeed(analogRead(0));
    int n_train = NUM_ROWS;
    float n_test = NUM_ROWS * (10 / 100);
    int dist[n_train]; 

    float test_indices[int(n_test)][2];
    int x;
    for (int i = 0; i < int(n_test); i++) {
      x = random(NUM_ROWS);
      test_indices[i][0] = x_train[x][0];
      test_indices[i][1] = x_train[x][1];
    }
    // Find the k nearest neighbors
    for (int i = 0; i < k; i++) {
      int minDistIndex = i;
      for (int j = i + 1; j < n_train; j++) {
        if (dist[j] < dist[minDistIndex]) {
          minDistIndex = j;
        }
      }

      // Swap the distances and labels
      int tmpDist = dist[i];
      dist[i] = dist[minDistIndex];
      dist[minDistIndex] = tmpDist;
      float tmpLabel0 = y_train[i][0];
      float tmpLabel1 = y_train[i][1];
      y_train[i][0] = y_train[minDistIndex][0];
      y_train[i][1] = y_train[minDistIndex][1];
      y_train[minDistIndex][0] = tmpLabel0;
      y_train[minDistIndex][1] = tmpLabel1;
    }
    // Find the majority label
    float count0 = 0;
    float count1 = 0;
    float sum0 = 0;
    float sum1 = 0;
    for (int i = 0; i < k; i++) {
      sum0 += y_train[i][0];
      sum1 += y_train[i][1];
    }
    float prediction0 = sum0 / k;
    float prediction1 = sum1 / k;

    Serial.println("Test data.. ");
    Serial.print("Fan Speed Prediction: ");
    Serial.println(prediction0);
    Serial.print("a/C value Prediction: ");
    Serial.println(prediction1);
  } 
}






















